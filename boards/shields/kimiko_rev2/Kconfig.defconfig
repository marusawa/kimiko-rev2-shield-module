## boards/shields/kimiko_rev2/Kconfig.defconfig
```kconfig
if SHIELD_KIMIKO_LEFT

config ZMK_KEYBOARD_NAME
    default "Kimiko"

config ZMK_SPLIT_ROLE_CENTRAL
    default y

config ZMK_USB
    default true

endif

if SHIELD_KIMIKO_LEFT || SHIELD_KIMIKO_RIGHT

config ZMK_SPLIT
    default y

endif
```
